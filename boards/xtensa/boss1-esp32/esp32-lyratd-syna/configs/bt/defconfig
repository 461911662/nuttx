## boards/xtensa/esp32s3/20260409-boss0/Kconfig
```kconfig
#
# For a description of the syntax of this configuration file,
# see the file kconfig-language.txt in the NuttX tools repository.
#

if ARCH_BOARD_20260409_BOSS0

config 20260409_BOSS0_GPIO_EXP
    bool "GPIO Expander (XL9555)"
    select I2C
    select IOEXPANDER
    select DEV_GPIO
    select GPIO_LOWER_HALF
    select IOEXPANDER_XL9555_INT
    select IOEXPANDER_INT_ENABLE
    select ESP32S3_I2C0
    select ESP32S3_GPIO_IRQ
    help
        Enable GPIO expander support using XL9555 with interrupt.
        This provides /dev/gpio0 through /dev/gpio15 for the 16
        GPIO pins on the XL9555 IO expander.

if 20260409_BOSS0_GPIO_EXP

config 20260409_BOSS0_GPIO_EXP_IRQ_PIN
    int "GPIO Expander IRQ Pin"
    default 16
    range 0 48
    help
        GPIO pin for XL9555 INT (interrupt output).

config 20260409_BOSS0_GPIO_EXP_ADDR
    hex "GPIO Expander I2C Address"
    default 0x20
    help
        I2C address of XL9555 (0x08-0x77).

config 20260409_BOSS0_GPIO_EXP_FREQ
    int "GPIO Expander I2C Frequency (Hz)"
    default 400000
    help
        I2C bus frequency for XL9555 communication.

endif

endif # ARCH_BOARD_20260409_BOSS0
```

## boards/xtensa/esp32s3/esp32s3-boss1-cx/Kconfig
```kconfig
#
# For a description of the syntax of this configuration file,
# see the file kconfig-language.txt in the NuttX tools repository.
#

if ARCH_BOARD_ESP32S3_BOSS1_CX

config ESP32S3_BOSS1_CX_GPIO_EXP
    bool "GPIO Expander (XL9555)"
    select I2C
    select IOEXPANDER
    select DEV_GPIO
    select GPIO_LOWER_HALF
    select IOEXPANDER_XL9555_INT
    select IOEXPANDER_INT_ENABLE
    select ESP32S3_I2C0
    select ESP32S3_GPIO_IRQ
    help
        Enable GPIO expander support using XL9555 with interrupt.
        This provides /dev/gpio0 through /dev/gpio15 for the 16
        GPIO pins on the XL9555 IO expander.

if ESP32S3_BOSS1_CX_GPIO_EXP

config ESP32S3_BOSS1_CX_GPIO_EXP_IRQ_PIN
    int "GPIO Expander IRQ Pin"
    default 17
    range 0 48
    help
        GPIO pin for XL9555 INT (interrupt output).

config ESP32S3_BOSS1_CX_GPIO_EXP_ADDR
    hex "GPIO Expander I2C Address"
    default 0x20
    help
        I2C address of XL9555 (0x08-0x77).

config ESP32S3_BOSS1_CX_GPIO_EXP_FREQ
    int "GPIO Expander I2C Frequency (Hz)"
    default 400000
    help
        I2C bus frequency for XL9555 communication.

endif

config ESP32S3_BOSS1_CX_I2S0
    bool "I2S Microphone (LMD4030)"
    default n
    help
        Enable I2S for LMD4030 PDM microphone (master mode)

if ESP32S3_BOSS1_CX_I2S0

config ESP32S3_BOSS1_CX_I2S0_TX
    bool "I2S0 TX (Output)"
    default n

config ESP32S3_BOSS1_CX_I2S0_RX
    bool "I2S0 RX (Input)"
    default y

endif

config ESP32S3_BOSS1_CX_SPEAKER
    bool "Speaker Power Control (NS4168)"
    depends on ESP32S3_BOSS1_CX_GPIO_EXP
    select ESPRESSIF_I2S1
    help
        Enable speaker power control via XL9555 IO0 for NS4168 amplifier.
        This wraps I2S1 audio with GPIO control to enable/disable the speaker.

config ESP32S3_BOSS1_CX_LCD_I80
    bool "LCD I80 (ST7789 8-bit parallel)"
    depends on ESP32S3_BOSS1_CX_GPIO_EXP
    depends on ESP32S3_LCD_I80
    select IOEXPANDER
    select IOEXPANDER_XL9555
    help
        Enable I80 LCD support for BOSS1-CX board using ST7789V
        in 8-bit parallel mode via ESP32-S3 LCD_CAM controller.

if ESP32S3_BOSS1_CX_LCD_I80

config ESP32S3_BOSS1_CX_LCD_I80_WIDTH
    int "LCD Width (pixels)"
    default 320

config ESP32S3_BOSS1_CX_LCD_I80_HEIGHT
    int "LCD Height (pixels)"
    default 240

config ESP32S3_BOSS1_CX_LCD_I80_BPP
    int "LCD Bits Per Pixel"
    default 16

config ESP32S3_BOSS1_CX_LCD_I80_BL_XL9555_PIN
    int "Backlight XL9555 Pin"
    default 12
    range 0 15
    help
        XL9555 GPIO pin number for LCD backlight control.

config ESP32S3_BOSS1_CX_LCD_I80_RST_XL9555_PIN
    int "Reset XL9555 Pin"
    default 13
    range 0 15
    help
        XL9555 GPIO pin number for LCD reset control.

config ESP32S3_BOSS1_CX_LCD_I80_D0_PIN
    int "LCD D0 Pin"
    default 40
    range 0 48

config ESP32S3_BOSS1_CX_LCD_I80_D1_PIN
    int "LCD D1 Pin"
    default 38
    range 0 48

config ESP32S3_BOSS1_CX_LCD_I80_D2_PIN
    int "LCD D2 Pin"
    default 39
    range 0 48

config ESP32S3_BOSS1_CX_LCD_I80_D3_PIN
    int "LCD D3 Pin"
    default 48
    range 0 48

config ESP32S3_BOSS1_CX_LCD_I80_D4_PIN
    int "LCD D4 Pin"
    default 45
    range 0 48

config ESP32S3_BOSS1_CX_LCD_I80_D5_PIN
    int "LCD D5 Pin"
    default 21
    range 0 48

config ESP32S3_BOSS1_CX_LCD_I80_D6_PIN
    int "LCD D6 Pin"
    default 47
    range 0 48

config ESP32S3_BOSS1_CX_LCD_I80_D7_PIN
    int "LCD D7 Pin"
    default 14
    range 0 48

config ESP32S3_BOSS1_CX_LCD_I80_DC_PIN
    int "LCD DC Pin"
    default 1
    range 0 48

config ESP32S3_BOSS1_CX_LCD_I80_CS_PIN
    int "LCD CS Pin"
    default 2
    range 0 48

config ESP32S3_BOSS1_CX_LCD_I80_WR_PIN
    int "LCD WR (PCLK) Pin"
    default 41
    range 0 48

endif # ESP32S3_BOSS1_CX_LCD_I80

config ESP32S3_BOSS1_CX_TOUCHSCREEN_FT6336U
    bool "FT6336U Touchscreen"
    depends on ESP32S3_BOSS1_CX_GPIO_EXP
    select INPUT
    select INPUT_FT5X06
    select ESP32S3_I2C1
    help
        Enable FT6336U touchscreen on BOSS1-CX board via I2C1.
        The touchscreen INT signal is connected to XL9555 IO9,
        and the RST signal is connected to XL9555 IO8.

if ESP32S3_BOSS1_CX_TOUCHSCREEN_FT6336U

config ESP32S3_BOSS1_CX_TOUCH_XL9555_RST_PIN
    int "Touch RST XL9555 Pin"
    default 8
    range 0 15
    help
        XL9555 GPIO pin number for FT6336U reset control (active low).

config ESP32S3_BOSS1_CX_TOUCH_XL9555_INT_PIN
    int "Touch INT XL9555 Pin"
    default 9
    range 0 15
    help
        XL9555 GPIO pin number connected to FT6336U INT output.
        This pin detects touch events (active low, falling edge).

endif # ESP32S3_BOSS1_CX_TOUCHSCREEN_FT6336U

endif # ARCH_BOARD_ESP32S3_BOSS1_CX
```
